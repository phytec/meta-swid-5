## conf/layer.conf
```bitbake
# We have a conf and classes directory, add to BBPATH
BBPATH .= ":${LAYERDIR}"

# We have a recipes directory, add to BBFILES
BBFILES += "${LAYERDIR}/recipes-*/*/*.bb \
            ${LAYERDIR}/recipes-*/*/*.bbappend"

BBFILE_COLLECTIONS += "swid-5"
BBFILE_PATTERN_swid-5 = "^${LAYERDIR}/"
BBFILE_PRIORITY_swid-5 = "21"
LAYERSERIES_COMPAT_swid-5 = "scarthgap" 
```
